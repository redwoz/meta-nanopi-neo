## conf/layer.conf
```bitbake
# We have a conf directory, append to BBPATH
BBPATH .= ":${LAYERDIR}"

# We have a recipes directory, add to BBFILES
BBFILES += "${LAYERDIR}/recipes-*/*/*.bb \
            ${LAYERDIR}/recipes-*/*/*.bbappend"

BBFILE_COLLECTIONS += "meta-nanopi-neo"
BBFILE_PATTERN_meta-nanopi-neo := "^${LAYERDIR}/"
BBFILE_PRIORITY_meta-nanopi-neo = "8"
```

## conf/machine/nanopi-neo.conf
```bitbake
#@TYPE: Machine
#@NAME: nanopi-neo
#@DESCRIPTION: Machine configuration for nanopi-neo

require conf/machine/include/sun8i.inc

#PREFERRED_PROVIDER_virtual/kernel = "linux-megous"
PREFERRED_PROVIDER_virtual/kernel = "linux-erazor"
PREFERRED_VERSION_linux = "4.9"

PREFERRED_PROVIDER_virtual/bootloader = "u-boot"
PREFERRED_VERSION_u-boot = "v2016.03%"

KERNEL_DEVICETREE = "sun8i-h3-nanopi-neo-air.dtb"
UBOOT_MACHINE = "nanopi_neo_air_defconfig"

MACHINE_EXTRA_RRECOMMENDS += " kernel-modules linux-firmware-brcm43438"
MACHINE_EXTRA_FEATURES += "ext2 serial usbgadget usbhost vfat bluez5 bluetooth wifi"
# KERNEL_MODULE_AUTOLOAD += " g_serial"
```
